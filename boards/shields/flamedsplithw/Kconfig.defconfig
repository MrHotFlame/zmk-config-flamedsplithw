## boards/shields/flamedsplithw/Kconfig.defconfig
```kconfig
if SHIELD_FLAMEDSPLITHW

config ZMK_KEYBOARD_NAME
    default "flamedsplithw"

config BT_DEVICE_NAME
    default flamedsplithw
    
endif
```

## boards/shields/flamedsplithw/Kconfig.shield
```kconfig
config SHIELD_FLAMEDSPLITHW
    def_bool $(shields_list_contains, flamedsplithw)
```

## config/boards/flamedsplithw/Kconfig.defconfig
```kconfig
if SHIELD_FLAMEDSPLITHW

config ZMK_KEYBOARD_NAME
    default "flamedsplithw"

endif
```
